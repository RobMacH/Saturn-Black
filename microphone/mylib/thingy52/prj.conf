## prj.conf
```kconfig
CONFIG_AUDIO=y
CONFIG_AUDIO_DMIC=y

CONFIG_LOG=y
CONFIG_RTT_CONSOLE=y

CONFIG_BT=y
CONFIG_BT_SMP=y
CONFIG_BT_PERIPHERAL=y
CONFIG_BT_DIS=y
CONFIG_BT_DIS_PNP=n
CONFIG_BT_BAS=y
CONFIG_BT_HRS=y
CONFIG_BT_DEVICE_NAME="Thingy Audio"
CONFIG_BT_DEVICE_APPEARANCE=833

# CONFIG_BT_L2CAP_LOG_LEVEL_DBG=y
# CONFIG_BT_BUF_ACL_RX_SIZE=251
# CONFIG_BT_L2CAP_RX_MTU = 247
# CONFIG_BT_BUF_ACL_TX_SIZE=247
```

## boards/thingy52_nrf52832.overlay
```dts
&pinctrl {
	pdm0_default_alt: pdm0_default_alt {
		group1 {
			psels = <NRF_PSEL(PDM_CLK, 0, 26)>,
				<NRF_PSEL(PDM_DIN, 0, 25)>;
		};
	};
};

dmic_dev: &pdm0 {
	status = "okay";
	pinctrl-0 = <&pdm0_default_alt>;
	pinctrl-names = "default";
	clock-source = "PCLK32M_HFXO";
};
```

## src/main.c
```c
/*
 * Copyright (c) 2021 Nordic Semiconductor ASA
 *
 * SPDX-License-Identifier: Apache-2.0
 */

#include <zephyr/kernel.h>
#include <zephyr/audio/dmic.h>

#include <zephyr/bluetooth/bluetooth.h>
#include <zephyr/bluetooth/conn.h>
#include <zephyr/bluetooth/gatt.h>

#include <zephyr/logging/log.h>
#include "../../../mylib/microphone.h"
#include <stdint.h>
#include "../../../mylib/bluetooth_audio.h"
#include <zephyr/sys/printk.h>

// Thread definitions
#define BLUETOOTH_PRIORITY 3
#define BLUETOOTH_STACK 7000
#define MIC_PRIORITY 4
#define MIC_STACK 4096

int main(void)
{

	//mic_init();
	//bluetooth_hr_init();
	return 0;
}

// Thread definitions
K_THREAD_DEFINE(bluetooth_hr_tid, BLUETOOTH_STACK, bluetooth_audio_init, NULL, NULL, NULL, BLUETOOTH_PRIORITY, 0, 0);
K_THREAD_DEFINE(mic_tid, MIC_STACK, mic_init, NULL, NULL, NULL, MIC_PRIORITY, 0, 0);
```
