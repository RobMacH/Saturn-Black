## CMakeLists.txt
```
# SPDX-License-Identifier: Apache-2.0

cmake_minimum_required(VERSION 3.20.0)

find_package(Zephyr REQUIRED HINTS $ENV{ZEPHYR_BASE})
project(dmic)

set(MYLIB_PATH ../../mylib)

set(INCLUDE_PATH ../../include)

zephyr_library_include_directories(${ZEPHYR_BASE}/samples/bluetooth)

target_sources(app PRIVATE src/main.c)

target_sources(app PRIVATE ${MYLIB_PATH}/microphone.c)
#target_sources(app PRIVATE ${MYLIB_PATH}/microphone_test.c)
target_sources(app PRIVATE ${MYLIB_PATH}/bluetooth_audio.c)
#target_sources(app PRIVATE ${MYLIB_PATH}/bluetooth_audio_test.c)
target_sources(app PRIVATE ${MYLIB_PATH}/audio_service.c)
#target_sources(app PRIVATE ${MYLIB_PATH}/audio_service_test.c)
target_include_directories(app PRIVATE ${INCLUDE_PATH})
```

## prj.conf
```kconfig
CONFIG_AUDIO=y
CONFIG_AUDIO_DMIC=y

CONFIG_LOG=y
CONFIG_RTT_CONSOLE=y
```

## src/main.c
```c
/*
 * Copyright (c) 2021 Nordic Semiconductor ASA
 *
 * SPDX-License-Identifier: Apache-2.0
 */

#include <zephyr/kernel.h>
#include <zephyr/audio/dmic.h>

#include <zephyr/logging/log.h>
LOG_MODULE_REGISTER(dmic_sample);

#define MAX_SAMPLE_RATE  16000
#define SAMPLE_BIT_WIDTH 16
#define BYTES_PER_SAMPLE sizeof(int16_t)
/* Milliseconds to wait for a block to be read. */
#define READ_TIMEOUT     1000

/* Size of a block for 100 ms of audio data. */
#define BLOCK_SIZE(_sample_rate, _number_of_channels) \
	(BYTES_PER_SAMPLE * (_sample_rate / 10) * _number_of_channels)

/* Driver will allocate blocks from this slab to receive audio data into them.
 * Application, after getting a given block from the driver and processing its
 * data, needs to free that block.
 */
#define MAX_BLOCK_SIZE   BLOCK_SIZE(MAX_SAMPLE_RATE, 2)
#define BLOCK_COUNT      4
K_MEM_SLAB_DEFINE_STATIC(mem_slab, MAX_BLOCK_SIZE, BLOCK_COUNT, 4);

static int do_pdm_transfer(const struct device *dmic_dev,
			   struct dmic_cfg *cfg,
			   size_t block_count)
{
	int ret;

	LOG_INF("PCM output rate: %u, channels: %u",
		cfg->streams[0].pcm_rate, cfg->channel.req_num_chan);

	ret = dmic_configure(dmic_dev, cfg);
	if (ret < 0) {
		LOG_ERR("Failed to configure the driver: %d", ret);
		return ret;
	}

	ret = dmic_trigger(dmic_dev, DMIC_TRIGGER_START);
	if (ret < 0) {
		LOG_ERR("START trigger failed: %d", ret);
		return ret;
	}

	while (1) {
		for (int i = 0; i < block_count; ++i) {
			void *buffer;
			uint32_t size;

			ret = dmic_read(dmic_dev, 0, &buffer, &size, READ_TIMEOUT);
			if (ret < 0) {
				LOG_ERR("%d - read failed: %d", i, ret);
				return ret;
			}
			//printk("New line to take up space\n\r");
			printk("%d - got buffer %p of %u bytes\n\r", i, buffer, size);

			k_mem_slab_free(&mem_slab, buffer);
		}
		k_sleep(K_MSEC(1000));
	}

	ret = dmic_trigger(dmic_dev, DMIC_TRIGGER_STOP);
	if (ret < 0) {
		LOG_ERR("STOP trigger failed: %d", ret);
		return ret;
	}

	return ret;
}

int main(void)
{
	const struct device *const dmic_dev = DEVICE_DT_GET(DT_NODELABEL(dmic_dev));
	int ret;

	LOG_INF("DMIC sample");

	if (!device_is_ready(dmic_dev)) {
		LOG_ERR("%s is not ready", dmic_dev->name);
		return 0;
	}

	struct pcm_stream_cfg stream = {
		.pcm_width = SAMPLE_BIT_WIDTH,
		.mem_slab  = &mem_slab,
	};
	struct dmic_cfg cfg = {
		.io = {
			/* These fields can be used to limit the PDM clock
			 * configurations that the driver is allowed to use
			 * to those supported by the microphone.
			 */
			.min_pdm_clk_freq = 1000000,
			.max_pdm_clk_freq = 3500000,
			.min_pdm_clk_dc   = 40,
			.max_pdm_clk_dc   = 60,
		},
		.streams = &stream,
		.channel = {
			.req_num_streams = 1,
		},
	};

	cfg.channel.req_num_chan = 1;
	cfg.channel.req_chan_map_lo =
		dmic_build_channel_map(0, 0, PDM_CHAN_LEFT);
	cfg.streams[0].pcm_rate = MAX_SAMPLE_RATE;
	cfg.streams[0].block_size =
		BLOCK_SIZE(cfg.streams[0].pcm_rate, cfg.channel.req_num_chan);

	ret = do_pdm_transfer(dmic_dev, &cfg, 2 * BLOCK_COUNT);
	if (ret < 0) {
		return 0;
	}

	// cfg.channel.req_num_chan = 2;
	// cfg.channel.req_chan_map_lo =
	// 	dmic_build_channel_map(0, 0, PDM_CHAN_LEFT) |
	// 	dmic_build_channel_map(1, 0, PDM_CHAN_RIGHT);
	// cfg.streams[0].pcm_rate = MAX_SAMPLE_RATE;
	// cfg.streams[0].block_size =
	// 	BLOCK_SIZE(cfg.streams[0].pcm_rate, cfg.channel.req_num_chan);

	// ret = do_pdm_transfer(dmic_dev, &cfg, 2 * BLOCK_COUNT);
	// if (ret < 0) {
	// 	return 0;
	// }

	LOG_INF("Exiting");
	return 0;
}
```

## include/audio_service.h
```c
#ifndef AUDIO_SERVICE_H_
#define AUDIO_SERVICE_H_
#include <zephyr/types.h>
#include <stddef.h>
#include <string.h>
#include <errno.h>
#include <zephyr/sys/printk.h>
#include <zephyr/sys/byteorder.h>
#include <zephyr/kernel.h>

#include <zephyr/bluetooth/bluetooth.h>
#include <zephyr/bluetooth/hci.h>
#include <zephyr/bluetooth/conn.h>
#include <zephyr/bluetooth/uuid.h>
#include <zephyr/bluetooth/gatt.h>
#include <zephyr/bluetooth/services/hrs.h>
#include <stdint.h>
#include <zephyr/sys/util.h>
#include <zephyr/bluetooth/byteorder.h>

/* Define UUID for Audio Service and Characteristic */
#define BT_UUID_AUDIO_VAL 0x1798
#define BT_UUID_AUDIO \
        BT_UUID_DECLARE_16(BT_UUID_AUDIO_VAL)
#define BT_UUID_AUDIO_DATA_VAL 0x1799
#define BT_UUID_AUDIO_DATA \
        BT_UUID_DECLARE_16(BT_UUID_AUDIO_DATA_VAL)

/** @brief Initialize the Audio Service. */
void audio_service_init(void);

/** @brief Initialize Bluetooth audio. */
int bluetooth_audio_init(void);

/** @brief Send a 16-bit PCM audio value. */
void audio_notify(uint16_t pcm_value);
// extern void audio_notify(uint16_t* buffer);



#endif /* AUDIO_SERVICE_H_ */
```

## include/bluetooth_audio.h
```c
#ifndef BLUETOOTH_AUDIO_H_
#define BLUETOOTH_AUDIO_H_

// bluetooth audio functions
// void audio_notify(uint16_t* buffer);
int bluetooth_audio_init(void);
#endif
```

## include/microphone.h
```c
/*
 * Copyright (c) 2021 Nordic Semiconductor ASA
 *
 * SPDX-License-Identifier: Apache-2.0
 */
#ifndef MICROPHONE_H_
#define MICROPHONE_H_

#include <zephyr/kernel.h>
#include <zephyr/audio/dmic.h>

#include <zephyr/logging/log.h>
#define MSG_SIZE 16

// Frequency and bit width
#define MAX_SAMPLE_RATE  16000
#define SAMPLE_BIT_WIDTH 16
#define BYTES_PER_SAMPLE sizeof(int16_t)
/* Milliseconds to wait for a block to be read. */
#define READ_TIMEOUT     5000

/* Size of a block for 100 ms of audio data. */
#define BLOCK_SIZE(_sample_rate, _number_of_channels) \
	(BYTES_PER_SAMPLE * (_sample_rate / 10) * _number_of_channels)

/* Driver will allocate blocks from this slab to receive audio data into them.
 * Application, after getting a given block from the driver and processing its
 * data, needs to free that block.
 */
#define MAX_BLOCK_SIZE   BLOCK_SIZE(MAX_SAMPLE_RATE, 1)
#define BLOCK_COUNT      2

int do_pdm_transfer(const struct device *dmic_dev,
			   struct dmic_cfg *cfg,
			   size_t block_count);
int mic_init(void);

#endif
```

## include/microphone_test.h
```c
/*
 * Copyright (c) 2021 Nordic Semiconductor ASA
 *
 * SPDX-License-Identifier: Apache-2.0
 */
#ifndef MICROPHONE_H_
#define MICROPHONE_H_

#include <zephyr/kernel.h>
#include <zephyr/audio/dmic.h>

#include <zephyr/logging/log.h>
#define MSG_SIZE 16

// Sampling Frequency
#define AUDIO_FREQ          16000
// Samples per ms
#define SAMPLE_WIDTH        AUDIO_FREQ / 1000 
// Bytes per samples
#define BYTES_PER_SAMPLE    sizeof(int16_t)
// Block size for 1ms of data (each sample is int16_t)
#define PCM_BLK_SIZE_MS     ((SAMPLE_WIDTH) * BYTES_PER_SAMPLE) // 16 * 2 = 32B
// How many MS of audio we can record
#define NUM_MS              100
// Total slab/buffer size in Bytes
#define SLAB_SIZE           PCM_BLK_SIZE_MS * NUM_MS 
// Number of spaces in a uint16 array (buffer)
#define BUF_SIZE            SLAB_SIZE / BYTES_PER_SAMPLE 

/* Milliseconds to wait for a block to be read. */
#define READ_TIMEOUT     5000


int do_pdm_transfer(const struct device *dmic_dev,
			   struct dmic_cfg *cfg);
int mic_init(void);

#endif
```
